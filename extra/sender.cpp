#include <Arduino.h>
#include <IRremote.hpp>

const int INDICATOR_PIN = 2; // In-built LED indicator (GPIO 2)
const int IR_SEND_PIN = 4;   // Pin connected to your IR transmitter LED

// Most air conditioners modulate signals on a 38kHz carrier frequency
const int AC_FREQUENCY_KHZ = 38;

// ============================================================================
// RAW AC CLONE ARRAYS (211 elements each)
// ============================================================================

const uint16_t rawTurnOff[] = {
    9300, 4200, 850, 1450, 800, 1450, 750, 350,
    700, 450, 650, 450, 650, 450, 700, 1550,
    650, 1600, 650, 450, 650, 450, 700, 450,
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    600, 1650, 600
};

const uint16_t rawTurnOn[] = {
    9050, 4500, 550, 1700, 550, 1700, 550, 600,
    500, 600, 550, 550, 550, 550, 550, 1700,
    550, 1700, 550, 550, 550, 600, 550, 550,
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    550, 1700, 550
};

const uint16_t rawTimer30Min[] = {
    9300, 4250, 800, 1450, 800, 1450, 800, 300,
    750, 400, 700, 400, 650, 500, 650, 1600,
    650, 1600, 600, 500, 650, 450, 650, 450,
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    550, 550, 600
};

// ============================================================================
// MODULAR TRANSMISSION FUNCTIONS (Cleaned of manual digitalWrites)
// ============================================================================

void turnOn() {
    Serial.println(F("[IR] Sending: AC TURN ON"));
    
    size_t signalLength = sizeof(rawTurnOn) / sizeof(rawTurnOn[0]);
    IrSender.sendRaw(rawTurnOn, signalLength, AC_FREQUENCY_KHZ);
}

void turnOff() {
    Serial.println(F("[IR] Sending: AC TURN OFF"));
    
    size_t signalLength = sizeof(rawTurnOff) / sizeof(rawTurnOff[0]);
    IrSender.sendRaw(rawTurnOff, signalLength, AC_FREQUENCY_KHZ);
}

void start30MinTimer() {
    Serial.println(F("[IR] Sending: AC 30-MIN TIMER"));
    
    size_t signalLength = sizeof(rawTimer30Min) / sizeof(rawTimer30Min[0]);
    IrSender.sendRaw(rawTimer30Min, signalLength, AC_FREQUENCY_KHZ);
}

// ============================================================================
// SETUP & MAIN EXECUTION LOOP
// ============================================================================

void setup() {
    Serial.begin(115200);
    delay(500);

    pinMode(INDICATOR_PIN, OUTPUT);
    digitalWrite(INDICATOR_PIN, LOW); 
    delay(100);
    
    Serial.println(F("\n______________________________________"));
    Serial.println(F("ESP32 AC Transmitter Initialized."));
    
    // FIXED: Explicitly map the hardware feedback LED pin instead of using the boolean flag macro
    IrSender.begin(IR_SEND_PIN, INDICATOR_PIN);
    
    Serial.print(F("Ready to fire IR blasters at GPIO pin: "));
    Serial.println(IR_SEND_PIN);
    Serial.println(F("Commands: Type '1' for ON, '0' for OFF, 'T' for 30M Timer."));
}

void loop() {
    if (Serial.available() > 0) {
        char targetCommand = Serial.read();
        
        while (Serial.available() > 0 && (Serial.peek() == '\n' || Serial.peek() == '\r')) {
            Serial.read();
        }
        
        switch (targetCommand) {
            case '1':
                turnOn();
                break;
            case '0':
                turnOff();
                break;
            case 'T':
            case 't':
                start30MinTimer();
                break;
            default:
                Serial.print(F("Unknown request: '"));
                Serial.print(targetCommand);
                Serial.println(F("'. Use 1, 0, or T."));
                break;
        }
    }
}